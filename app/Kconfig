## app/Kconfig
```kconfig
menuconfig LED_SUBSYSTEM
    bool "LED Subsystem"
    default y

    if LED_SUBSYSTEM
        choice
            prompt "LED blink sleep time (1s (medium))"
            default BLINK_NORMAL

            config BLINK_SLOW
                bool "Slow (2s)"
                help
                    Slow blink speed (2 seconds).

            config BLINK_NORMAL
                bool "Normal (1 second)"
                help
                    Normal blink speed (1 second).

            config BLINK_FAST
                bool "Fast (0.5 seconds)"
                help
                    Fast blink speed (0.5 seconds).
        endchoice

        config BLINK_SLEEP_TIME_MS
            int
            default 2000 if BLINK_SLOW
            default 1000 if BLINK_NORMAL
            default 500 if BLINK_FAST
            default 0

        config APP_HEARTBEAT_PERIOD_MS
            int "App Heartbeat Period (ms)"
            default 500
            range 100 2000

        menuconfig LED_ADVANCED_SETTINGS
            bool "Advanced LED settings"
            default n

            if LED_ADVANCED_SETTINGS
                config LED_BRIGHTNESS
                    int "LED Brightness (0-100)"
                    default 100
                    range 0 100

                config LED_FADE_DURATION_MS
                    int "LED Fade Duration (ms)"
                    default 500
                    range 0 1000

                menu "Expert settings"
                    config LED_DEBUGGING_STATUS
                        bool "Enable LED debugging"
                        default n

                    config LED_CUSTOM_BLINK_PATTERN
                        bool "Custom blink pattern"
                        default n
                endmenu
            endif
    endif

source "Kconfig.zephyr"
```

## app/boards/rh_temp_lux_sensor/Kconfig.defconfig
```kconfig
if BOARD_RH_TEMP_LUX_SENSOR

config LOG_BACKEND_SWO_FREQ_HZ
	default 875000
	depends on LOG_BACKEND_SWO

config FPU
	default y if SOC_GECKO_USE_RAIL || BT

if BT

config MAIN_STACK_SIZE
	default 3072 if PM
	default 2304

endif # BT

endif # BOARD_RH_TEMP_LUX_SENSOR
```

## app/boards/rh_temp_lux_sensor/board.yml
```yaml
boards:
  - name: rh_temp_lux_sensor
    full_name: RH Temperature and Light Sensor Board
    vendor: mala90n
    socs:
      - name: mgm260pd32vna
```
